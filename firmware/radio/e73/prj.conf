## CMakeLists.txt
```
cmake_minimum_required(VERSION 3.20.0)
find_package(Zephyr REQUIRED HINTS $ENV{ZEPHYR_BASE})
project(svc_e73_radio)

target_sources(app PRIVATE
    src/main.c
    src/ble_uart_bridge.c
    src/mcuboot_control.c
    src/telemetry_stub.c
    ../../update/update_state.c
)
target_include_directories(app PRIVATE
    src
    ../../update
)
```

## west.yml
```
manifest:
  version: "1.2"
  remotes:
    - name: zephyrproject
      url-base: https://github.com/zephyrproject-rtos
  projects:
    - name: zephyr
      remote: zephyrproject
      revision: v4.2.0
      import: true
  self:
    path: svc-platform
```

## prj.conf
```kconfig
CONFIG_MAIN_STACK_SIZE=4096
CONFIG_HEAP_MEM_POOL_SIZE=4096

CONFIG_LOG=y
CONFIG_LOG_DEFAULT_LEVEL=3

CONFIG_SERIAL=y
CONFIG_CONSOLE=y
CONFIG_UART_CONSOLE=y

CONFIG_BT=y
CONFIG_BT_PERIPHERAL=y
CONFIG_BT_DEVICE_NAME="SVC-E73"
CONFIG_BT_DEVICE_APPEARANCE=0
CONFIG_BT_SMP=y
CONFIG_BT_BONDABLE=y
CONFIG_BT_SETTINGS=y
CONFIG_SETTINGS=y
CONFIG_BT_MAX_CONN=1

CONFIG_MCUMGR=y
CONFIG_MCUMGR_TRANSPORT_BT=y
CONFIG_MCUMGR_GRP_IMG=y
CONFIG_IMG_MANAGER=y
CONFIG_MCUBOOT_IMG_MANAGER=y
CONFIG_STREAM_FLASH=y
CONFIG_FLASH=y
CONFIG_FLASH_MAP=y

CONFIG_BOOTLOADER_MCUBOOT=y
```

## src/main.c
```c
#include <errno.h>
#include <zephyr/bluetooth/bluetooth.h>
#include <zephyr/bluetooth/conn.h>
#include <zephyr/kernel.h>
#include <zephyr/logging/log.h>

#include "ble_uart_bridge.h"
#include "telemetry_stub.h"
#include "update_state.h"

LOG_MODULE_REGISTER(svc_e73, LOG_LEVEL_INF);

static svc_e73_telemetry_stub_t telemetry;
static svc_update_transfer_t update_transfer;

static void connected(struct bt_conn *connection, uint8_t error)
{
    if (error != 0U) {
        LOG_WRN("BLE connection failed: %u", error);
        return;
    }

    const int security_error = bt_conn_set_security(connection, BT_SECURITY_L2);
    if (security_error != 0 && security_error != -EALREADY) {
        LOG_WRN("BLE security request failed: %d", security_error);
    }
}

static void disconnected(struct bt_conn *connection, uint8_t reason)
{
    (void)connection;
    LOG_INF("BLE disconnected: %u", reason);
    if (update_transfer.state == SVC_UPDATE_RECEIVING) {
        (void)svc_update_interrupt(&update_transfer);
    }
}

BT_CONN_CB_DEFINE(connection_callbacks) = {
    .connected = connected,
    .disconnected = disconnected
};

int main(void)
{
    svc_e73_telemetry_stub_init(&telemetry);
    svc_update_transfer_init(&update_transfer);

    const int uart_error = svc_e73_uart_bridge_init();
    if (uart_error != 0) {
        LOG_WRN("UART bridge unavailable: %d", uart_error);
    }

    const int bluetooth_error = bt_enable(NULL);
    if (bluetooth_error != 0) {
        LOG_ERR("Bluetooth initialization failed: %d", bluetooth_error);
        return bluetooth_error;
    }

    const int advertising_error = bt_le_adv_start(
        BT_LE_ADV_CONN_FAST_1,
        NULL,
        0,
        NULL,
        0);
    if (advertising_error != 0) {
        LOG_ERR("Advertising failed: %d", advertising_error);
        return advertising_error;
    }

    LOG_INF("SVC E73 scaffold ready; telemetry remains unavailable until UART data");
    for (;;) {
        k_sleep(K_SECONDS(1));
    }
    return 0;
}
```

## src/ble_uart_bridge.c
```c
#include "ble_uart_bridge.h"

#include <errno.h>
#include <zephyr/device.h>
#include <zephyr/devicetree.h>
#include <zephyr/drivers/uart.h>

static const struct device *const bridge_uart =
    DEVICE_DT_GET(DT_CHOSEN(zephyr_console));

int svc_e73_uart_bridge_init(void)
{
    return device_is_ready(bridge_uart) ? 0 : -ENODEV;
}

int svc_e73_uart_bridge_write(const uint8_t *data, size_t length)
{
    if (data == NULL && length != 0U) {
        return -EINVAL;
    }
    if (!device_is_ready(bridge_uart)) {
        return -ENODEV;
    }

    for (size_t data_index = 0U; data_index < length; ++data_index) {
        uart_poll_out(bridge_uart, data[data_index]);
    }
    return 0;
}

int svc_e73_uart_bridge_read(uint8_t *data, size_t capacity, size_t *length)
{
    if (data == NULL || length == NULL) {
        return -EINVAL;
    }
    if (!device_is_ready(bridge_uart)) {
        return -ENODEV;
    }

    size_t received = 0U;
    while (received < capacity) {
        unsigned char byte = 0U;
        if (uart_poll_in(bridge_uart, &byte) != 0) {
            break;
        }
        data[received] = byte;
        received += 1U;
    }

    *length = received;
    return 0;
}
```

## src/ble_uart_bridge.h
```c
#pragma once

#include <stddef.h>
#include <stdint.h>

int svc_e73_uart_bridge_init(void);

int svc_e73_uart_bridge_write(const uint8_t *data, size_t length);

int svc_e73_uart_bridge_read(uint8_t *data, size_t capacity, size_t *length);
```

## src/mcuboot_control.c
```c
#include "mcuboot_control.h"

#include <errno.h>
#include <zephyr/dfu/mcuboot.h>

int svc_e73_request_test_boot(void)
{
    return boot_request_upgrade(BOOT_UPGRADE_TEST);
}

int svc_e73_confirm_running_image(bool health_checks_passed)
{
    if (!health_checks_passed) {
        return -EPERM;
    }

    return boot_write_img_confirmed();
}
```

## src/mcuboot_control.h
```c
#pragma once

#include <stdbool.h>

int svc_e73_request_test_boot(void);

int svc_e73_confirm_running_image(bool health_checks_passed);
```

## src/telemetry_stub.c
```c
#include "telemetry_stub.h"

#include <stddef.h>

#include "update_state.h"

void svc_e73_telemetry_stub_init(svc_e73_telemetry_stub_t *telemetry)
{
    if (telemetry == NULL) {
        return;
    }

    *telemetry = (svc_e73_telemetry_stub_t){
        .protocol_version = SVC_UPDATE_PROTOCOL_V1,
        .telemetry_available = false
    };
}

void svc_e73_telemetry_stub_set_stm32_connected(
    svc_e73_telemetry_stub_t *telemetry,
    bool connected)
{
    if (telemetry == NULL) {
        return;
    }

    telemetry->stm32_connected = connected;
    if (!connected) {
        telemetry->telemetry_available = false;
    }
}
```

## src/telemetry_stub.h
```c
#pragma once

#include <stdbool.h>
#include <stdint.h>

typedef struct {
    uint16_t protocol_version;
    uint32_t sequence;
    bool stm32_connected;
    bool telemetry_available;
} svc_e73_telemetry_stub_t;

void svc_e73_telemetry_stub_init(svc_e73_telemetry_stub_t *telemetry);

void svc_e73_telemetry_stub_set_stm32_connected(
    svc_e73_telemetry_stub_t *telemetry,
    bool connected);
```
